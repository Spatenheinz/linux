## thesis/Kconfig
```kconfig
config RUST_WIP
	tristate "Work In Progress Proof checker"
	help
	  This option builds the Rust virtual device module sample.

	  To compile this as a module, choose M here:
	  the module will be called thesis-checker.

	  If unsure, say N.
```
